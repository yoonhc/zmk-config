#include "../behavior_keymap.dtsi"

&default_layer {
    bindings = <
        &caps_multi_overlap_tunable_test 35 &kp A
        &kp C                              &none
    >;
};

&kscan {
    events = <
        ZMK_MOCK_PRESS(0, 0, 40)
        ZMK_MOCK_RELEASE(0, 0, 80)
        ZMK_MOCK_PRESS(0, 0, 20)
        ZMK_MOCK_PRESS(0, 1, 30)
        ZMK_MOCK_RELEASE(0, 1, 30)
        ZMK_MOCK_RELEASE(0, 0, 30)
    >;
};

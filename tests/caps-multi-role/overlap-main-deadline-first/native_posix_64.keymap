#include "../behavior_keymap.dtsi"

&default_layer {
    bindings = <
        &caps_multi_overlap_test &kp A
        &kp C                   &none
    >;
};

&kscan {
    events = <
        ZMK_MOCK_PRESS(0, 0, 230)
        ZMK_MOCK_PRESS(0, 1, 30)
        /* The original 260 ms deadline arrives five ms before the overlap deadline. */
        ZMK_MOCK_RELEASE(0, 1, 20)
        ZMK_MOCK_RELEASE(0, 0, 20)
    >;
};

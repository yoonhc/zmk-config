#include "../behavior_keymap.dtsi"

&default_layer {
    bindings = <
        &caps_multi_overlap_tunable_test 50 &kp A
        &kp C                              &none
    >;
};

&kscan {
    events = <
        ZMK_MOCK_PRESS(0, 0, 10)
        ZMK_MOCK_PRESS(0, 1, 35)
        /* The same overlap that exceeds 20 ms remains a tap with a 50 ms term. */
        ZMK_MOCK_RELEASE(0, 0, 20)
        ZMK_MOCK_RELEASE(0, 1, 20)
    >;
};

#include "../behavior_keymap.dtsi"

&default_layer {
    bindings = <
        &caps_multi_overlap_test &kp A
        &kp C                   &none
    >;
};

&kscan {
    events = <
        ZMK_MOCK_PRESS(0, 0, 50)
        ZMK_MOCK_PRESS(0, 1, 20)
        /* Caps wins before the 35 ms overlap deadline, so flush LANG1 first. */
        ZMK_MOCK_RELEASE(0, 0, 30)
        ZMK_MOCK_RELEASE(0, 1, 20)
        /* Keep the simulator alive past both cancelled deadlines. */
        ZMK_MOCK_PRESS(1, 1, 300)
        ZMK_MOCK_RELEASE(1, 1, 10)
    >;
};

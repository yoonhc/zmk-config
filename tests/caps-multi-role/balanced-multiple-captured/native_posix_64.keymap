#include "../behavior_keymap.dtsi"

&default_layer {
    bindings = <
        &caps_multi_balanced_test &kp A
        &kp C                    &none
    >;
};

&kscan {
    events = <
        ZMK_MOCK_PRESS(0, 0, 40)
        ZMK_MOCK_PRESS(0, 1, 20)
        ZMK_MOCK_PRESS(1, 0, 20)
        ZMK_MOCK_RELEASE(0, 0, 20)
        ZMK_MOCK_RELEASE(1, 0, 20)
        ZMK_MOCK_RELEASE(0, 1, 20)
    >;
};

#include "../behavior_keymap.dtsi"

&kscan {
    events = <
        ZMK_MOCK_PRESS(0, 0, 40)
        ZMK_MOCK_RELEASE(0, 0, 80)
        ZMK_MOCK_PRESS(0, 0, 20)
        ZMK_MOCK_PRESS(0, 1, 30)
        ZMK_MOCK_RELEASE(0, 1, 30)
        ZMK_MOCK_RELEASE(0, 0, 30)
    >;
};

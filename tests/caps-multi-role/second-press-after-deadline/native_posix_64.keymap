#include "../behavior_keymap.dtsi"

&kscan {
    events = <
        ZMK_MOCK_PRESS(0, 0, 40)
        ZMK_MOCK_RELEASE(0, 0, 221)
        /* Safely beyond 260 ms; old LANG1 resolves before a new sequence. */
        ZMK_MOCK_PRESS(0, 0, 40)
        ZMK_MOCK_RELEASE(0, 0, 300)
        ZMK_MOCK_PRESS(1, 1, 10)
        ZMK_MOCK_RELEASE(1, 1, 10)
    >;
};

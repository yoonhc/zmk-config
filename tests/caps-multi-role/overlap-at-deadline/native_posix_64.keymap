#include "../behavior_keymap.dtsi"

&default_layer {
    bindings = <
        &caps_multi_overlap_test &kp A
        &kp C                   &none
    >;
};

&kscan {
    events = <
        ZMK_MOCK_PRESS(0, 0, 20)
        ZMK_MOCK_PRESS(0, 1, 35)
        /* Caps releases first at exactly 35 ms, which is on the Ctrl side. */
        ZMK_MOCK_RELEASE(0, 0, 20)
        ZMK_MOCK_RELEASE(0, 1, 20)
    >;
};

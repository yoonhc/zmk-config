## Kconfig
```kconfig
# SPDX-License-Identifier: MIT

menuconfig ZMK_BEHAVIOR_CAPS_MULTI_ROLE
    bool "Caps multi-role behavior"
    default y
    depends on DT_HAS_ZMK_BEHAVIOR_CAPS_MULTI_ROLE_ENABLED || \
               DT_HAS_ZMK_BEHAVIOR_CAPS_MULTI_ROLE_TUNABLE_ENABLED
    help
      Enable the timestamp-driven Caps multi-role behavior.

if ZMK_BEHAVIOR_CAPS_MULTI_ROLE

config ZMK_BEHAVIOR_CAPS_MULTI_ROLE_MAX_ACTIVE
    int "Maximum active Caps multi-role keys"
    default 4
    range 1 16
    help
      Maximum number of Caps multi-role sequences tracked at once.

config ZMK_BEHAVIOR_CAPS_MULTI_ROLE_MAX_CAPTURED_EVENTS
    int "Maximum events captured by a deferred Caps multi-role key"
    default 16
    range 2 64
    help
      Maximum number of position events buffered while a balanced or
      overlap Caps multi-role key waits for resolution.

endif
```

## config/west.yml
```yaml
manifest:
  remotes:
    - name: zmkfirmware
      url-base: https://github.com/zmkfirmware
    - name: yangdigi
      url-base: https://github.com/yangdigi
  projects:
    - name: zmk
      remote: zmkfirmware
      revision: 4ec69cb7e658590adf6354027aca789b364a70c5
      import: app/west.yml
    - name: zmk-keyboards-klink
      remote: yangdigi
      revision: e80a8335563aec32a8f2c47cba697077291bfb99
      path: modules/zmk-keyboards-klink
  self:
    path: config
```

## dts/bindings/behaviors/zmk,behavior-caps-multi-role.yaml
```yaml
# SPDX-License-Identifier: MIT

description: Timestamp-driven Caps multi-role behavior

compatible: "zmk,behavior-caps-multi-role"

include: zero_param.yaml

properties:
  bindings:
    type: phandle-array
    required: true
    description: Tap, hold, and momentary-layer bindings

  tapping-term-ms:
    type: int
    required: true
    description: Logical deadline measured from the first press timestamp

  overlap-term-ms:
    type: int
    default: 35
    description: Minimum simultaneous press time before an overlap interrupt resolves as hold

  interrupt-flavor:
    type: string
    required: false
    default: "hold-preferred"
    enum:
      - "hold-preferred"
      - "balanced"
      - "overlap"
    description: How another key resolves an undecided first press
```
